## arch/arm/mach-imx/imx8/Kconfig
```kconfig
if ARCH_IMX8

config IMX8
	bool

config MU_BASE_SPL
	hex "MU base address used in SPL"
	default 0x5d1b0000
	help
	  SPL runs in EL3 mode, it use MU0_A to communicate with SCU.
	  So we could not reuse the one in dts which is for normal U-Boot.

config IMX8QM
	select IMX8
	select SUPPORT_SPL
	bool

config IMX8QXP
	select IMX8
	select SUPPORT_SPL
	bool

config SYS_SOC
	default "imx8"

config SPL_LOAD_IMX_CONTAINER
	bool "Enable SPL loading U-Boot as a i.MX Container image"
	depends on SPL
	help
	  This is to let SPL could load i.MX8 Container image

config IMX_CONTAINER_CFG
	string "i.MX Container config file"
	depends on SPL
	help
	  This is to specific the cfg file for generating container
	  image which will be loaded by SPL.

choice
	prompt "i.MX8 board select"
	optional

config TARGET_IMX8QXP_MEK
	bool "Support i.MX8QXP MEK board"
	select BOARD_LATE_INIT
	select IMX8QXP

config TARGET_IMX8QM_MEK
	bool "Support i.MX8QM MEK board"
	select BOARD_LATE_INIT
	select IMX8QM

endchoice

source "board/freescale/imx8qxp_mek/Kconfig"
source "board/freescale/imx8qm_mek/Kconfig"

endif
```

## drivers/clk/imx/Kconfig
```kconfig
config CLK_IMX8
	bool "Clock support for i.MX8"
	depends on ARCH_IMX8
	select CLK
	help
	  This enables support clock driver for i.MX8 platforms.

config CLK_IMX8MM
	bool "Clock support for i.MX8MM"
	depends on IMX8MM
	select CLK
	help
	  This enables support clock driver for i.MX8 platforms.
```
